## packages/gadget/c/esp32/main/Kconfig.projbuild
```kconfig
menu "ragu gadget"

config RAGU_WIFI_SSID
    string "Wi-Fi SSID"
    default ""

config RAGU_WIFI_PASSWORD
    string "Wi-Fi password"
    default ""

config RAGU_SERVER
    string "Bridge URL"
    default "http://192.168.1.10:4097"

config RAGU_PAIR_CODE
    string "Pairing code (used once; the token is then kept in NVS)"
    default ""

config RAGU_NAME
    string "Gadget name"
    default "esp32-gadget"

config RAGU_BUTTON_GPIO
    int "Button GPIO (active low, internal pull-up); -1 for none"
    default 0

config RAGU_LED_GPIO
    int "LED GPIO; -1 for none"
    default 8

config RAGU_LED_ACTIVE_LOW
    bool "LED is active low"
    default y

endmenu
```
